## Chronos/Kconfig
```kconfig
#
# For a description of the syntax of this configuration file,
# see the file kconfig-language.txt in the NuttX tools repository.
#

config EXAMPLES_CUSTOMM_APP
	tristate "\"CUSTOMM_APP, World!\" example"
	default n
	---help---
		Enable the \"Hello, World!\" example

if EXAMPLES_CUSTOMM_APP

config EXAMPLES_CUSTOMM_APP_PROGNAME
	string "Program name"
	default "hello"
	---help---
		This is the name of the program that will be used when the NSH ELF
		program is installed.

config EXAMPLES_CUSTOMM_APP_PRIORITY
	int "Hello task priority"
	default 100

config EXAMPLES_CUSTOMM_APP_STACKSIZE
	int "Hello stack size"
	default DEFAULT_TASK_STACKSIZE

endif
```

## CustomApps/Example_Template/Kconfig
```kconfig
#
# For a description of the syntax of this configuration file,
# see the file kconfig-language.txt in the NuttX tools repository.
#

config CUSTOMAPPS_EXAMPLE
	tristate "\"Hello, World!\" example"
	default n
	---help---
		Enable the \"Hello, World!\" example

if CUSTOMAPPS_EXAMPLE

config CUSTOMAPPS_EXAMPLE_PROGNAME
	string "Program name"
	default "Example_Template"
	---help---
		This is the name of the program that will be used when the NSH ELF
		program is installed.

config CUSTOMAPPS_EXAMPLE_PRIORITY
	int "Hello task priority"
	default 100

config CUSTOMAPPS_EXAMPLE_STACKSIZE
	int "Hello stack size"
	default DEFAULT_TASK_STACKSIZE

endif
```
